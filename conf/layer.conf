## conf/layer.conf
```bitbake
BBPATH .= ":${LAYERDIR}"

BBFILES += "${LAYERDIR}/recipes-*/*/*.bb \
            ${LAYERDIR}/recipes-*/*/*.bbappend"

BBFILE_COLLECTIONS += "armorcheck"
BBFILE_PATTERN_armorcheck := "^${LAYERDIR}/"
BBFILE_PRIORITY_armorcheck = "7"

LAYERDEPENDS_armorcheck = "core openembedded-layer"
LAYERSERIES_COMPAT_armorcheck = "wrynose"
```
